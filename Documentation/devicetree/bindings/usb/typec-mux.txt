## Documentation/devicetree/bindings/usb/typec-mux.txt
```
USB Type-C Multiplexer/DeMultiplexer Switch

Optional properties:
 - have-2ch-usbss : The hardware has support for 2ch USB SS.
 - have-4ch-am : The hardware has support for 4ch Alternate Mode.
 - have-2ch-usbss-2ch-am : The hardware has support for 2ch USB SS + 2ch
     Alternate Mode.
 - have-4ch-usbss : The hardware has support for 4ch USB SS.
 - have-2ch-usbss-2ch-am-b : The hardware has support for 2ch USB SS + 2ch
     Alternate Mode, alternate pair.
 - default-mux-mode: Mux mode to use after initial connection.

Example :
pi3usb30532@00 {
	compatible = "pericom,pi3usb30532";
	reg = <0x00>;
	have-2ch-usbss;
	have-4ch-am;
	default-mux-mode = <2ch-usbss>;
};
```

## drivers/usb/typec/mux/Kconfig
```kconfig
menu "USB Type-C Multiplexer/DeMultiplexer Switch support"

config TYPEC_MUX_PI3USB30532
	tristate "Pericom PI3USB30532 Type-C cross switch driver"
	depends on I2C
	help
	  Say Y or M if your system has a Pericom PI3USB30532 Type-C cross
	  switch / mux chip found on some devices with a Type-C port.

config TYPEC_MUX_TIHD3SS460
	tristate "TI HD3SS460 USB Type-C Alternate Mode MUX driver"
	depends on GPIOLIB
	help
	  Say Y or M if your system has a Texas Instruments HD3SS460 Type-C
	  Alternate Mode MUX chip found on some devices with a Type-C port.

endmenu
```
